/* AWINIC AW8624 Haptic */
&i2c0 {
	aw8624_haptic@5A {
		compatible = "awinic,aw8624_haptic";
		reg = <0x5A>;
		reset-gpio = <&pio 63 0>;
		irq-gpio = <&pio 1 0>;
                vib_mode = < 0 >;  /*mode: RAM mode->0; CONT mode -> 1*/
		vib_f0_pre = < 2609 >;
		vib_f0_cali_percen = < 7 >;
		vib_cont_drv_lev = < 125 >;
		vib_cont_drv_lvl_ov = < 155 >;
		vib_cont_td = < 0xF06C >;
		vib_cont_zc_thr = < 0x0FF1 >;  /* wt 0x0FF1*/
		vib_cont_num_brk = < 3 >;
		vib_f0_coeff = < 260 >;  /*Don't modify it*/
		vib_duration_time = < 11 25 0 0 0 >;
		vib_brake_ram_config = < 1 1 80 40 20 3 1 1    1 1 100 40 20 7 3 1    1 1 100 80 40 7 5 1 >;
		vib_brake_cont_config = < 1 1 90 42 20 5 2 2 0 0 0  0  0  0 0 0 0 0 0   0  0  0 0 0 >;
		vib_f0_trace_parameter = < 9 3 1 31 >;
		vib_bemf_config = < 0x10 0x08 0x23 0xf8 >;
		vib_sw_brake = < 0x2c >;
		vib_wavseq = < 0 1 1 2 0 0 0 0 0 0 0 0 0 0 0 0 >; /*wavseq1-seq8 0x07-0x0E*/
		vib_wavloop = < 0 6 1 15 0 0 0 0 0 0>;/*loop1-mainloog 0x0f-0x13*/
		vib_td_brake = < 51264 46992 46992 >; /*level0  level1  level2*/
		vib_tset = < 0x11 >;
                vib_func_parameter1 = < 1000 >;
		status = "okay";
	};
};

/* AWINIC AW8624 Haptic End */
